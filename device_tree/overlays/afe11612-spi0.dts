/dts-v1/;
/plugin/;

/ {
    compatible = "brcm,bcm2835";

    fragment@0 {
        target = <&spi0>;
        __overlay__ {
            status = "okay";

            #address-cells = <1>;
            #size-cells = <0>;

            afe11612: afe11612@0 {
                compatible = "ti,afe11612";
                reg = <0>;                      // CS0 on SPI0
                spi-max-frequency = <1000000>;
                spi-cpha; //SPI MODE 1
            };
        };
    };
};