/dts-v1/;
/plugin/;

/ {
    compatible = "brcm,bcm2835";

    fragment@0 {
        target = <&spi1>;
        __overlay__ {
            status = "okay";

            // Explicit, required for SPI children
            #address-cells = <1>;
            #size-cells = <0>;

            apio16: apio16@0 {
                compatible = "apogee,apio16";
                reg = <0>;                      // CS0 on SPI1
                spi-max-frequency = <1000000>;
            };
        };
    };
};